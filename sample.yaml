## sample.yaml
```yaml
sample:
  description: A simple integration test application  by hand 
  name: hello-test 
common:
  build_only: true
  integration_platforms:
    - stm32f4_disco
tests:
  app.default: {}
  app.debug :
    extra_overlay_confs
```

## tests/hello_test/testcase.yaml
```yaml
tests:
  hello.test_hello:
    platform_allow:
      - native_sim
      - stm32f4_disco
    tags: test
    timeout: 10
```
